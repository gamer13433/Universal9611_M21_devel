## drivers/Kconfig
```kconfig
# SPDX-License-Identifier: GPL-2.0
menu "Device Drivers"

source "drivers/amba/Kconfig"

source "drivers/base/Kconfig"

source "drivers/of/Kconfig"

source "drivers/block/Kconfig"

# misc before ide - BLK_DEV_SGIIOC4 depends on SGI_IOC4

source "drivers/misc/Kconfig"

source "drivers/muic/Kconfig"

source "drivers/scsi/Kconfig"

source "drivers/md/Kconfig"

source "drivers/net/Kconfig"

# input before char - char/joystick depends on it. As does USB.

source "drivers/input/Kconfig"

source "drivers/char/Kconfig"

source "drivers/i2c/Kconfig"

source "drivers/spi/Kconfig"

source "drivers/hsi/Kconfig"

source "drivers/pinctrl/Kconfig"

source "drivers/gpio/Kconfig"

source "drivers/power/Kconfig"

source "drivers/hwmon/Kconfig"

source "drivers/thermal/Kconfig"

source "drivers/watchdog/Kconfig"

source "drivers/mfd/Kconfig"

source "drivers/regulator/Kconfig"

source "drivers/media/Kconfig"

source "drivers/video/Kconfig"

source "drivers/pwm/Kconfig"

source "sound/Kconfig"

source "drivers/hid/Kconfig"

source "drivers/usb/Kconfig"

source "drivers/mmc/Kconfig"

source "drivers/leds/Kconfig"

source "drivers/rtc/Kconfig"

source "drivers/dma/Kconfig"

source "drivers/dma-buf/Kconfig"

source "drivers/hv/Kconfig"

source "drivers/staging/Kconfig"

source "drivers/clk/Kconfig"

source "drivers/clocksource/Kconfig"

source "drivers/iommu/Kconfig"

source "drivers/soc/Kconfig"

source "drivers/devfreq/Kconfig"

source "drivers/extcon/Kconfig"

source "drivers/iio/Kconfig"

source "drivers/irqchip/Kconfig"

source "drivers/phy/Kconfig"

source "drivers/perf/Kconfig"

source "drivers/android/Kconfig"

source "drivers/dax/Kconfig"

source "drivers/nvmem/Kconfig"

source "drivers/bts/Kconfig"

source "drivers/gud/Kconfig"

source "drivers/battery/Kconfig"

source "drivers/battery_v2/Kconfig"

source "drivers/switch/Kconfig"

source "drivers/vision/Kconfig"

source "drivers/samsung/Kconfig"

source "drivers/security/samsung/five_tee_driver/Kconfig"

source "drivers/sensorhub/Kconfig"

source "drivers/vibrator/Kconfig"

source "drivers/fingerprint/Kconfig"

source "drivers/security/samsung/icdrv/Kconfig"

source "drivers/security/samsung/tzic/Kconfig"

source "drivers/spu_verify/Kconfig"
endmenu
```

## drivers/cpufreq/Kconfig
```kconfig
menu "CPU Frequency scaling"

config CPU_FREQ
	bool "CPU Frequency scaling"
	select SRCU
	help
	  CPU Frequency scaling allows you to change the clock speed of 
	  CPUs on the fly. This is a nice method to save power, because 
	  the lower the CPU clock speed, the less power the CPU consumes.

	  Note that this driver doesn't automatically change the CPU
	  clock speed, you need to either enable a dynamic cpufreq governor
	  (see below) after boot, or use a userspace tool.

	  For details, take a look at <file:Documentation/cpu-freq>.

	  If in doubt, say N.

if CPU_FREQ

config CPU_FREQ_GOV_ATTR_SET
	bool

config CPU_FREQ_GOV_COMMON
	select CPU_FREQ_GOV_ATTR_SET
	select IRQ_WORK
	bool

config CPU_FREQ_BOOST_SW
	bool
	depends on THERMAL

config CPU_FREQ_STAT
	bool "CPU frequency transition statistics"
	help
	  Export CPU frequency statistics information through sysfs.

	  If in doubt, say N.

config CPU_FREQ_TIMES
       bool "CPU frequency time-in-state statistics"
       help
         Export CPU time-in-state information through procfs.

         If in doubt, say N.

choice
	prompt "Default CPUFreq governor"
	default CPU_FREQ_DEFAULT_GOV_USERSPACE if ARM_SA1100_CPUFREQ || ARM_SA1110_CPUFREQ
	default CPU_FREQ_DEFAULT_GOV_SCHEDUTIL
	help
	  This option sets which CPUFreq governor shall be loaded at
	  startup. If in doubt, select 'performance'.

config CPU_FREQ_DEFAULT_GOV_SCHEDUTIL
	bool "schedutil"
	depends on SMP
	select CPU_FREQ_GOV_SCHEDUTIL
	select CPU_FREQ_GOV_PERFORMANCE
	help
	  Use the 'schedutil' CPUFreq governor by default. If unsure,
	  have a look at the help section of that governor. The fallback
	  governor will be 'performance'.

endchoice

config CPU_FREQ_GOV_SCHEDUTIL
	bool "'schedutil' cpufreq policy governor"
	depends on CPU_FREQ && SMP
	select CPU_FREQ_GOV_ATTR_SET
	select IRQ_WORK
	help
	  This governor makes decisions based on the utilization data provided
	  by the scheduler.  It sets the CPU frequency to be proportional to
	  the utilization/capacity ratio coming from the scheduler.  If the
	  utilization is frequency-invariant, the new frequency is also
	  proportional to the maximum available frequency.  If that is not the
	  case, it is proportional to the current frequency of the CPU.  The
	  frequency tipping point is at utilization/capacity equal to 80% in
	  both cases.

	  If in doubt, say N.

config FREQVAR_TUNE
	bool "CPU frequency variant tuner"
	depends on SCHED_EMS && CPU_FREQ_GOV_SCHEDUTIL
	help
	  This option provides the controller which tunes system performance
	  as frequency variant.

	  Say N if unsure.

comment "CPU frequency scaling drivers"

if ARM || ARM64
source "drivers/cpufreq/Kconfig.arm"
endif

comment "P-state Boost Solutions"

choice EXYNOS_PSTATE
	prompt "P-state Boost Solution"
	default EXYNOS_PSTATE_DISABLE
	depends on ARCH_EXYNOS
	depends on CPU_FREQ
	help
	  Default status of P-state boost is disable.

config EXYNOS_PSTATE_DISABLE
	bool "disable"
	help
	  This option sets P-state boost solution as disable.
	  If in doubt, set this config.

config EXYNOS_PSTATE_HAFM
	bool "Exynos HAFM"
	help
	  This option sets P-state boost solution as HAFM.
	  The config makes HIU just deliver frequency level and power budget
	  given from CPUFreq driver and register set.

config EXYNOS_PSTATE_HAFM_TB
	bool "Exynos HAFM-TB"
	help
	  This option sets P-state boost solution as HAFM-TB.

config EXYNOS_PSTATE_MODE_CHANGER
	bool "Exynos Mode Changer"
	depends on HOTPLUG_CPU
	help
	  This option sets P-state boost solution as EMC.

endchoice

endif
endmenu
```

## drivers/cpufreq/Kconfig.arm
```kconfig
#
# ARM CPU Frequency scaling drivers
#

config ARM_EXYNOS_ACME
	bool "SAMSUNG EXYNOS ACME(A Cpufreq that Meets Every chipset) driver"
	depends on ARCH_EXYNOS
	  help
	  This adds the CPUFreq driver for every exynos chipset. Exynos
	  ACME supported SoC must use the exynos CAL framework.

	  If in doubt, say N.

config ARM_EXYNOS_UFC
	bool "SAMSUNG EXYNOS UFC(User Frequency Control) driver"
	depends on ARM_EXYNOS_ACME
	 help
	 This adds the User CPU Frequency Control driver for every exynos chipset.
	 Exynos UFC suppored SoC must use the exynos ACME driver.

	 If in doubt, say N.
```

## drivers/cpufreq/Kconfig.overclock
```kconfig
menu "Exynos cpu overclock"

config EXYNOS_OVERCLOCK
	bool "Exynos cpu overclock"
	depends on ARCH_EXYNOS
	default y
	---help---
	  Enable overclock of exynos cpu.
	  
config LITTLE_MINFREQ
	int "LITTLE cluster min cpu frequency"
	depends on EXYNOS_OVERCLOCK
	default 403000
	help
	  This sets minimal cpu frequency for little cluster.

config LITTLE_MAXFREQ
	int "LITTLE cluster max cpu frequency"
	depends on EXYNOS_OVERCLOCK
	default 1742000
	help
	  This sets maximal cpu frequency for little cluster
	  possible increased frequencies for Exynos961(0,1)
	  1846000 and 1950000.
	  
config BIG_MINFREQ
	int "BIG cluster min cpu frequency"
	depends on EXYNOS_OVERCLOCK
	default 936000
	help
	  This sets minimal cpu frequency for big cluster
	  possible decreased frequencies for Exynos961(0,1)
	  728000 and possibly less.
	  
config BIG_MAXFREQ
	int "BIG cluster max cpu frequency"
	depends on EXYNOS_OVERCLOCK
	default 2314000
	help
	  This sets maximal cpu frequency for big cluster
	  possible increased frequencies for Exynos961(0,1)
	  2496000 and 2600000.
endmenu
```
